/*
 * Desk-mouse (PMW3360) wiring for the Corne, split across both halves.
 *
 * Topology (matches the stock `corne` shield, where LEFT is central):
 *   - LEFT  half  = central     -> enables the input listener, sends HID.
 *   - RIGHT half  = peripheral  -> owns the physical PMW3360 on SPI and pushes
 *                                  motion to the central over the BLE split.
 *
 * The shared `zmk,input-split` channel + the (disabled) listener are defined on
 * BOTH halves so the keymap can reference them without an undefined node.
 * `#if CONFIG_ZMK_SPLIT_ROLE_CENTRAL` then splits the side-specific hardware.
 *
 * This file is #included from corne.keymap.
 */

#include <dt-bindings/zmk/input_transform.h>

/ {
    /* Shared between the halves: one pointer channel, reg = <0>. */
    split_inputs {
        #address-cells = <1>;
        #size-cells = <0>;

        trackball_split: trackball_split@0 {
            compatible = "zmk,input-split";
            reg = <0>;
        };
    };

    /* Runs on the central; disabled here, enabled below on the central build. */
    trackball_listener: trackball_listener {
        compatible = "zmk,input-listener";
        status = "disabled";
        device = <&trackball_split>;

        /* HOLD-TO-MOUSE (the Scoot interaction model): uncomment to only move
         * the cursor while a layer is held, so sliding the right half never
         * nudges the cursor mid-typing. Verify raw tracking works FIRST, then
         * enable this. Layer 1 = `upper` (hold the left thumb SPACE), which
         * already carries &mkp MB1/MB2 -> slide to move, MB1/MB2 to click. */
        // layers = <1>;
    };
};

#if IS_ENABLED(CONFIG_ZMK_SPLIT_ROLE_CENTRAL)

/* ----------------------------- LEFT / central ----------------------------- */
&trackball_listener {
    status = "okay";
};

#else

/* --------------------------- RIGHT / peripheral --------------------------- *
 * The physical sensor. Every pin below is a TODO: set them to whatever you
 * actually solder on the right half. Defaults are placeholders, NOT verified.
 * nRF pin syntax is NRF_PSEL(FUNC, port, pin) / <&gpioN pin flags>.
 */

&pinctrl {
    spi0_default: spi0_default {
        group1 {
            psels = <NRF_PSEL(SPIM_SCK,  0, 8)>,   /* TODO: SCK  */
                    <NRF_PSEL(SPIM_MOSI, 0, 6)>,   /* TODO: MOSI */
                    <NRF_PSEL(SPIM_MISO, 0, 17)>;  /* TODO: MISO */
        };
    };

    spi0_sleep: spi0_sleep {
        group1 {
            psels = <NRF_PSEL(SPIM_SCK,  0, 8)>,
                    <NRF_PSEL(SPIM_MOSI, 0, 6)>,
                    <NRF_PSEL(SPIM_MISO, 0, 17)>;
            low-power-enable;
        };
    };
};

&spi0 {
    status = "okay";
    compatible = "nordic,nrf-spim";
    pinctrl-0 = <&spi0_default>;
    pinctrl-1 = <&spi0_sleep>;
    pinctrl-names = "default", "sleep";
    cs-gpios = <&gpio0 20 GPIO_ACTIVE_LOW>;        /* TODO: CS */

    trackball: trackball@0 {
        compatible = "pixart,pmw3360";
        reg = <0>;
        spi-max-frequency = <2000000>;
        /* MOTION interrupt pin (recommended). Omit this line for polled mode. */
        irq-gpios = <&gpio0 22 (GPIO_ACTIVE_LOW | GPIO_PULL_UP)>;  /* TODO: MOTION */
        cpi = <800>;                               /* DPI; tune 400..3600 */
        /* rotate-90;  // enable if X/Y come out swapped for your mounting */
    };
};

/* Bind the physical sensor to the shared channel, on the peripheral side. */
&trackball_split {
    device = <&trackball>;

    /* A face-down desk sensor is often mirrored/rotated vs. what you expect.
     * Add fixups once you see how it moves, e.g.:
     * input-processors = <&zip_xy_transform (INPUT_TRANSFORM_X_INVERT)>; */
};

#endif /* CONFIG_ZMK_SPLIT_ROLE_CENTRAL */
